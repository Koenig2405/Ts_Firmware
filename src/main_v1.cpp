#include <Arduino.h>
#include <Wire.h>
#include <Adafruit_GFX.h>
#include <Adafruit_SSD1306.h>
#include <Encoder.h>
#include <TimerOne.h> 		// Timer Bibliothek

#define SCREEN_WIDTH 128 /*128 width of OLED in pixels*/
#define SCREEN_HEIGHT 64 /*64 height of OLED in pixels*/

Adafruit_SSD1306 display(SCREEN_WIDTH, SCREEN_HEIGHT, &Wire, -1); /*OLED display connected at I2C pins (SDA, SCL)*/

Encoder myEnc(2, 6);
const int EncSW = 3;

void enterInterrupt();    //interrupt for the Encoder Button
bool enterState = false;  //
long oldPosition = -999;

const int buzzer = 8;

int prg_cnt = 0;

enum FANSPEED
{
    low = 33,
    mid = 66,
    high = 100
};

void showBoot(); 
// 'BootScreen', 128x64px
const unsigned char bootScreen [] PROGMEM = {
	0x00, 0x00, 0x00, 0x00, 0x00, 0x00, 0x00, 0x00, 0x00, 0x00, 0x00, 0x00, 0x00, 0x00, 0x00, 0x00, 
	0x00, 0x00, 0x00, 0x00, 0x00, 0x00, 0x00, 0x00, 0x00, 0x00, 0x00, 0x00, 0x00, 0x00, 0x00, 0x00, 
	0x00, 0x00, 0x00, 0x00, 0x00, 0x00, 0x00, 0x00, 0x00, 0x00, 0x00, 0x00, 0x00, 0x00, 0x00, 0x00, 
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	0x00, 0x00, 0x00, 0x00, 0x00, 0x00, 0x00, 0x00, 0x00, 0x00, 0x00, 0x00, 0x00, 0x00, 0x00, 0x00
};

FANSPEED selectFanSpeed();
FANSPEED globalFanspeed = low;

int selectDuration();
int globalDuration = 30;

bool setAlarm();
bool globalAlarm = false;

#define LUEFTER_PIN 9 		
#define PWM_FREQUENZ 25000
bool turnFanOn();
bool fanFin;


void displaySetup()
{
    if (!display.begin(SSD1306_SWITCHCAPVCC, 0x3C))
    { /*I2C Address at which OLED will communicate*/
        Serial.println(F("SSD1306 allocation failed"));
        for (;;)
            ;
    }

    display.clearDisplay();                 /*Clear display*/
    display.setTextSize(2);                 /*OLED screen text size defined*/
    display.setTextColor(WHITE);            /*OLED screen text color*/
}

void setup() 
{
    Serial.begin(9600);
    displaySetup();

    pinMode(EncSW, INPUT);
    attachInterrupt(digitalPinToInterrupt(EncSW), enterInterrupt, FALLING);

    pinMode(buzzer, OUTPUT);
    digitalWrite(buzzer, true);
    
    Timer1.initialize(1000000/PWM_FREQUENZ);	// Initialisierung des PWM Timers
	Timer1.pwm(LUEFTER_PIN,0);			// PWM des Timers setzen, zunächst 0
	pinMode(LUEFTER_PIN,OUTPUT);
    Timer1.setPwmDuty(LUEFTER_PIN, map(0,0,100,0,1023));

}

void loop() 
{
    switch (prg_cnt)
    {
    case 0:
        showBoot();
        prg_cnt = 1;
        break;

    case 1:
        globalFanspeed = selectFanSpeed();
        enterState = false;
        prg_cnt = 2;
        break;

    case 2:
        globalDuration = selectDuration();
        enterState = false;
        prg_cnt = 3;
        break;

    case 3:
        globalAlarm = setAlarm();
        enterState = false;
        prg_cnt = 4;
        break;

    case 4:
        fanFin = turnFanOn();
        enterState = false;
        prg_cnt = 1;


    
    default:
        break;
    }
}

void enterInterrupt()
{
    delay(150);
    if(digitalRead(EncSW) == false)
    {
        enterState = true;
        digitalWrite(buzzer, false);
        Serial.println("Interrupt:: Button pressed!");
        delay(500);
        digitalWrite(buzzer, true);
    }
    EIFR = (0b11 << INTF0);
}

void showBoot()
{
    display.drawBitmap(0, 0, bootScreen, 128, 64, WHITE);
    display.display();
    Serial.println("BootScreen:: BootScreen");
    delay(1000);

    /*digitalWrite(buzzer, false);  //Bootup Sound
    delay(200);
    digitalWrite(buzzer, true);
    delay(200);
    digitalWrite(buzzer, false);
    delay(200);
    digitalWrite(buzzer, true);
    delay(200);
    digitalWrite(buzzer, false);
    delay(700);
    digitalWrite(buzzer, true);*/
}

FANSPEED selectFanSpeed()
{
    FANSPEED fanSpeed = low;
    myEnc.write(0);
    oldPosition = -999;

    while(true)
    {
        long newPosition = (-myEnc.read()/4) % 3 + 1;
        
        if (newPosition != oldPosition)
        {
            //Serial.println(newPosition);
            oldPosition = newPosition;
            switch (newPosition)
            {
            case 1:
                Serial.println("FanSpeed:: Niedrig");

                display.clearDisplay(); 
                display.setCursor(35, 12);
                display.println("STUFE:");
                display.setCursor(25, 36);
                display.println("Niedrig");
                display.display();
                fanSpeed = low;
                break;

            case 2:
            case -1:    //because of negative Values
                Serial.println("FanSpeed:: Mittel");

                display.clearDisplay();
                display.setCursor(35, 12);
                display.println("STUFE:"); 
                display.setCursor(32, 36);
                display.println("Mittel");
                display.display();
                fanSpeed = mid;
                break;
            
            case 3:
            case 0: //because of negative Values
                Serial.println("FanSpeed:: Hoch");

                display.clearDisplay(); 
                display.setCursor(35, 12);
                display.println("STUFE:");
                display.setCursor(42, 36);
                display.println("Hoch");
                display.display();
                fanSpeed = high;
                break;
            
            default:
                Serial.println("FanSpeed:: ERROR!");
                break;
            }
        }
        if (enterState == true)
        {
            oldPosition = -999;
            return fanSpeed;
        }
    }
}

int selectDuration()
{
    myEnc.write(-48);
    long newPosition;

    while (true)
    {    
        newPosition = (-myEnc.read()/4) * 10;

        if (newPosition != oldPosition)
        {
            if(newPosition < 10)
            {
                newPosition = 10;
                myEnc.write(-4);
            }
            if(newPosition > 240)
            {
                newPosition = 240;
                myEnc.write(-96);   //-94 da 1 klick 4 Werte sind
            }
            oldPosition = newPosition;

            Serial.print("Duration:: ");
            Serial.println(newPosition);
            display.clearDisplay(); 

            display.setCursor(35, 12);
            display.println("DAUER:");
              
            if(newPosition < 100)
            {
                display.setCursor(34, 36);
            }
            else
            {
                display.setCursor(26, 36);
            }

            display.print(newPosition);
            display.println(" min");
            display.display();
        }
        
        if (enterState == true)
        {
            oldPosition = -999;
            return newPosition;
        }
    }
}

bool setAlarm()
{
    myEnc.write(0);
    long newPosition;
    bool alarm = false;

    while(true)
    {
        newPosition = (-myEnc.read()/4) % 2 + 1;

         if (newPosition != oldPosition)
        {
            //Serial.println(newPosition);
            oldPosition = newPosition;
            switch (newPosition)
            {
            case 1:
                Serial.println("ALARM:: OFF");

                display.clearDisplay();
                display.setCursor(35, 12);
                display.println("ALARM:");
                display.setCursor(50, 36);
                display.println("OFF");
                display.display();
                alarm = false;
                break;

            case 2:
            case 0: //because of negative Values
                Serial.println("Alarm:: ON");
                display.clearDisplay(); 
                display.setCursor(35, 12);
                display.println("ALARM:");
                display.setCursor(55, 36);
                display.println("ON");
                display.display();
                alarm = true;
                break;
            
            default:
                break;
            }
        }
        if (enterState == true)
        {
            oldPosition = -999;
            return alarm;
        }
    }
}

bool turnFanOn()
{
    /*Timer1.setPwmDuty(LUEFTER_PIN, map(100,0,100,0,1023));
    Serial.println("turnFanOn::Fan spinning 100%");
    delay(5000);
    Timer1.setPwmDuty(LUEFTER_PIN, map(0,0,100,0,1023));
    Serial.println("turnFanOn::Fan spinning 0%");*/

    //long myTimer = millis();
    //long myTimeOut = globalDuration * 60 * 1000;
    //long myTimeOut = globalDuration * 10;

    Serial.print("turnFanOn::GlobalDuration = ");
    Serial.println(globalDuration * 10);

    Timer1.setPwmDuty(LUEFTER_PIN, map(globalFanspeed,0,100,0,1023));
                
    display.clearDisplay();
    display.setCursor(28, 24);
    display.println("Drying");
    display.display();

    delay(globalDuration * 60 * 10000);
    Timer1.setPwmDuty(LUEFTER_PIN, map(0,0,100,0,1023));

    display.clearDisplay();
    display.setCursor(14, 24);
    display.println("Finished!");
    display.display();

    while(true)
    {
        if((globalAlarm == true) && !enterState)
        {
            digitalWrite(buzzer, false);
            delay(200);
            digitalWrite(buzzer, true);
            delay(500);
        }

        if(enterState == true)
        {
            return true;
        }
    }
}